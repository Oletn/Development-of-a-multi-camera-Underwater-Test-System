#include <SPI.h>
#include <Wire.h>
#include <Adafruit_GFX.h>
#include <Adafruit_SH110X.h>
#include <RH_RF95.h>

  //********* Code is based on exapmple codes from the RadioHead git repor: https://github.com/adafruit/RadioHead ********** //
  //********* Code is based on examples from Adafruit SH110X Library ********************************************************// 

  /***** Oled feather with buttons ******/
  Adafruit_SH1107 display = Adafruit_SH1107(64, 128, &Wire);
  // Setting up the buttons on the Adafruit feather wing 
  #define BUTTON_A  9s
  #define BUTTON_B  6
  #define BUTTON_C  5

/***** LoRa Feather ******/
  // define frequnecy for the LoRa module
  #define RF95_FREQ 434.0
  // defining ports on the Adafruit LoRa Feather
  #define RFM95_CS    8
  #define RFM95_INT   3 //Datablad sier 7 men bibliotek sier 3 
  #define RFM95_RST   4
  #define LED        13
  // Singleton instance of the radio driver
  RH_RF95 rf95(RFM95_CS, RFM95_INT);  

/***** Global variables ******/
int16_t packetnum = 0;  // packet counter, we increment per xmission
int8_t lineControl(23); // controlls placement of letters on oled
unsigned long timerStart(0), timerStop(0); 




// 'iot-lora-alliance-logo', 128x64px
// generated a Bitmap of the LoRa Alliance Logo using https://javl.github.io/image2cpp/

const unsigned char lora_logo_bitmap [] PROGMEM = {
	0x00, 0x00, 0x00, 0x00, 0x00, 0x00, 0x00, 0x00, 0x00, 0x00, 0x00, 0x00, 0x00, 0x00, 0x00, 0x00, 
	0x00, 0x00, 0x00, 0x00, 0x00, 0x00, 0x00, 0x00, 0x00, 0x00, 0x00, 0x00, 0x00, 0x00, 0x00, 0x00, 
	0x00, 0x00, 0x00, 0x00, 0x00, 0x00, 0x00, 0x00, 0x00, 0x00, 0x00, 0x00, 0x00, 0x00, 0x00, 0x00, 
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	0x00, 0x00, 0x00, 0x00, 0x00, 0x00, 0x00, 0x00, 0x00, 0x00, 0x00, 0x00, 0x00, 0x00, 0x00, 0x00
};


void setup() {

  delay(500);
  //Serial.begin(115200);
  //while (!Serial) delay(1); // wait until serial console is open, remove if not tethered to computer

  //Serial.println("Serial is initialized");
  //Serial.println("128x64 OLED FeatherWing test");
  //delay(500); // wait for the OLED to power up

  display.begin(0x3C, true); // Address 0x3C default
  //Serial.println("OLED begun");

  //Display image buffer and internal splashscreen
  display.display();
  delay(1000);

  // Clear the buffer.
  display.clearDisplay();
  delay(100); 

  //setting rotation and displaying LoRa logo
  display.setRotation(1);
  display.drawBitmap(0, 0, lora_logo_bitmap, 128, 64, SH110X_WHITE);
  display.display();
  delay(3000); 

  // setting color and textsize
  display.clearDisplay();
  display.setTextSize(1);
  display.setTextColor(SH110X_WHITE);
  display.setCursor(0,0);


  pinMode(BUTTON_A, INPUT_PULLUP);
  pinMode(BUTTON_B, INPUT_PULLUP);
  pinMode(BUTTON_C, INPUT_PULLUP);

  pinMode(LED, OUTPUT);
  pinMode(RFM95_RST, OUTPUT);
  digitalWrite(RFM95_RST, HIGH);

  //Serial.println("Feather LoRa RX/TX Test!");

  // manual reset of the RFM95 LoRa 
  digitalWrite(RFM95_RST, LOW);
  delay(10);
  digitalWrite(RFM95_RST, HIGH);
  delay(10);

  // from radiohead example text
  if (!rf95.init()) {
    display.clearDisplay();
    display.println("LoRa radio init failed");
    display.println("Uncomment '#define SERIAL_DEBUG' in RH_RF95.cpp for detailed debug info");
    display.display();
    while (1);
  }
  display.clearDisplay();
  display.println("Radio init OK!");
  

  // Defaults after init are 434.0MHz, modulation GFSK_Rb250Fd250, +13dbM
  if (!rf95.setFrequency(RF95_FREQ)) {
    display.clearDisplay();
    display.println("setFrequency failed");
    display.display();
    while (1);
  }

//****** Calculating the legal effective radiated power after EN 300 220-2 standard *******// 

//  ERPmW = 10; %dBm
//  antennaGain = 0.7 - 2.15; %dBd
//  attenuationFactor = 93/100; %dB/m 
//  cableLength = 0.15; %m 
//  cableLoss = attenuationFactor * cableLength; %dB
//  txPower = ERPmW-antennaGain+cableLoss
//  Result = 11.5895 dBm
//  Bandwith is by default 125 kHz in the Radiohead Lib

  rf95.setTxPower(11, false);
  display.println();
  display.print("LoRa radio @"); display.print((int)RF95_FREQ); display.println(" MHz");
  display.display();
  delay(1000);
  
  //Starting the menu on the screen
  menu(); 

  delay(500); 
}

void loop() {
  //Checking for new inputs
  choice();
  yield();
}

void menu() {
  //Displaying the menu
  display.clearDisplay();
  delay(300);
  display.setTextSize(1);
  display.setTextColor(SH110X_WHITE);
  display.setCursor(0,0);
  display.print("LoRa Menu");
  display.setCursor(0,15);
  display.println("<- A: Power Switch"); 
  display.println(""); 
  display.println("<- B: Ping"); 
  display.println(""); 
  display.println("<- C: Read manual"); 
  display.display(); 
  delay(300); 
}

void choice(){
    //checking for input from buttons
    //Serial.println("Button pressed!");
    if (!digitalRead(BUTTON_A)){delay(300); sendAndrecieve();}
    if (!digitalRead(BUTTON_B)){delay(300); ping();}
    if (!digitalRead(BUTTON_C)){delay(300); manual();}
}

void ping(){
  //Sending a Ping message and waiting for a answere
  display.clearDisplay();
  delay(300); 
  display.setTextSize(2);
  display.setTextColor(SH110X_WHITE);
  display.setCursor(0,0);
  display.println("PING");
  display.display(); 
  char radiopacket[20] = "Button #C";
  radiopacket[9] = 0;
  delay(100); 
  rf95.send((uint8_t *)radiopacket, strlen(radiopacket));
  rf95.waitPacketSent();
  //Starting timer
  timerStart = millis();
  int8_t loop(1); 
  while(loop){
    if (rf95.available()) {
      //insert a timer stop here
      timerStop = millis() - timerStart;
      // Recieving a message
      uint8_t buf[RH_RF95_MAX_MESSAGE_LEN];
      uint8_t len = sizeof(buf);

      if (! rf95.recv(buf, &len)) {
        display.println("Receive failed");
        return;
      }
      digitalWrite(LED, HIGH);
      delay(500);
      RH_RF95::printBuffer("Received: ", buf, len);

      display.println("PONG"); 
      display.setTextSize(1);
      display.print("RSSI: "); display.print(rf95.lastRssi()); display.println(" dBm");
      display.print("Time: "); display.print(timerStop); display.println(" ms");
      display.display();
      digitalWrite(LED, LOW);
      delay(5000); 
      menu();
      loop=0; 
    }
  }
}

void manual(){
  //A small manual for describing the functionality
  display.clearDisplay();
  delay(300);
  display.setTextSize(1);
  display.setTextColor(SH110X_WHITE);
  display.setCursor(0,0);
  display.print("Manual:");
  display.drawLine(0, 9, 127, 9, SH110X_WHITE);
  display.setCursor(0,11);
  display.println("With this device one can send and recieve LoRa messages.");
  display.println("Choose program in the menu.");
  display.println("Press C for MENU.");
  display.display(); // actually display all of the above
  delay(100); 
  int8_t loop(1); 
  while(loop){
    if (!digitalRead(BUTTON_C)) {
      delay(300); 
      menu();
      loop=0; 
    }
  }
}

void sendAndrecieve() {
  //Turning on and off the Rig with messages
  display.clearDisplay();
  delay(300);
  display.setTextSize(1);
  display.setTextColor(SH110X_WHITE);
  display.setCursor(0,0);
  display.print("Power Switch");
  display.drawLine(0, 9, 127, 9, SH110X_WHITE);
  display.setCursor(0,11);
  display.println("ON:A | OFF:B | Menu:C");
  display.drawRect(0, 21, 127, 43, SH110X_WHITE);
  display.display(); // actually display all of the above
  int8_t loop(1); 
  while(loop){
    display.setCursor(2,lineControl);
    rx();
    tx();
    if(!digitalRead(BUTTON_C)){
      delay(300); 
      menu();
      loop=0; 
    }
    delay(10);
    display.display();
  }
}

void tx() {
  /*** Transmitting sequnece ***/
  if (!digitalRead(BUTTON_A) || !digitalRead(BUTTON_B)) {
    clearBox();
    lineControl=23;
    //Serial.println("Button pressed!");
    char radiopacket[20] = "Button #";
    if (!digitalRead(BUTTON_A)){delay(300); radiopacket[8] = 'A';}
    if (!digitalRead(BUTTON_B)){delay(300); radiopacket[8] = 'B';}
    radiopacket[9] = 0;

    //Serial.print("Sending "); Serial.println(radiopacket);
    display.setCursor(2, lineControl);
    display.println("Loading...");
    display.display(); 
    delay(500); 
    lineControl=lineControl+8; 
    rf95.send((uint8_t *)radiopacket, strlen(radiopacket));
    rf95.waitPacketSent();
  }
}

void rx() {
  /*** recieving sequnce ***/
 if (rf95.available()) {
    // Should be a message for us now
    uint8_t buf[RH_RF95_MAX_MESSAGE_LEN];
    uint8_t len = sizeof(buf);

    if (! rf95.recv(buf, &len)) {
      //Serial.println("Receive failed");
      return;
    }
    digitalWrite(LED, HIGH);
    delay(500);
    RH_RF95::printBuffer("Received: ", buf, len);
    //Serial.print("Got: "); Serial.println((char*)buf);
    //Serial.print("RSSI: "); Serial.println(rf95.lastRssi(), DEC);

    char radiopacket[20]; 
    strncpy(radiopacket, (char*)buf, len);
    radiopacket[len] = '\0'; // Null-terminate the string
    char test = radiopacket[8];
    if (test == 'A') {
      clearBox(); 
      display.println("Power is ON");
    }
    else if (test == 'B') {
      clearBox(); 
      display.println("Power is OFF");
    }
    display.display();
    lineControl=lineControl+16; 
    digitalWrite(LED, LOW);
  }
}

void clearBox() {
  //clearing the box 
  display.fillRect(1, 22, 125, 41, SH110X_BLACK);
  display.display();
}